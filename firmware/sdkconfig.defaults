## firmware/sdkconfig.defaults
```kconfig
# Kavix32 ESP32-S3 Firmware - Build Configuration

# Basic project settings
CONFIG_IDF_TARGET="esp32s3"
CONFIG_IDF_FIRMWARE_CHIP_ID=0x0009

# USB Device Support
CONFIG_TINYUSB_HID_COUNT=1
CONFIG_TINYUSB_CDC_ENABLED=y

# UART Configuration
CONFIG_ESP_CONSOLE_UART_BAUDRATE=460800
CONFIG_CONSOLE_UART_BAUDRATE=460800
CONFIG_ESP_CONSOLE_UART_DEFAULT=y
CONFIG_ESP_CONSOLE_SECONDARY_NONE=y
# CONFIG_USJ_ENABLE_USB_SERIAL_JTAG is not set
# CONFIG_ESP_CONSOLE_SECONDARY_USB_SERIAL_JTAG is not set
# CONFIG_ESP_CONSOLE_USB_SERIAL_JTAG_ENABLED is not set

# Flashing/boot behavior for normal development workflow
# CONFIG_ESPTOOLPY_NO_STUB is not set
CONFIG_ESPTOOLPY_BEFORE_RESET=y
CONFIG_ESPTOOLPY_AFTER_RESET=y
CONFIG_ESPTOOLPY_BEFORE="default_reset"
CONFIG_ESPTOOLPY_AFTER="hard_reset"
# Use the conservative speed that works across common ESP32-S3 boards.
# CONFIG_ESPTOOLPY_FLASHFREQ_80M is not set
CONFIG_ESPTOOLPY_FLASHFREQ_40M=y
CONFIG_ESPTOOLPY_HEADER_FLASHSIZE_UPDATE=y
CONFIG_PARTITION_TABLE_CUSTOM=y
CONFIG_PARTITION_TABLE_CUSTOM_FILENAME="partitions.csv"
CONFIG_PARTITION_TABLE_FILENAME="partitions.csv"
CONFIG_PARTITION_TABLE_OFFSET=0x8000

# FreeRTOS
CONFIG_FREERTOS_HZ=1000

# Logging
CONFIG_LOG_DEFAULT_LEVEL=3
CONFIG_LOG_MAXIMUM_LEVEL=5

# Heap
CONFIG_SPIRAM=n

# USB Device String Descriptors
CONFIG_TINYUSB_DESC_MANUFACTURER_STRING="Kavix32"
CONFIG_TINYUSB_DESC_PRODUCT_STRING="HID Emulation"
CONFIG_TINYUSB_DESC_SERIAL_STRING="KAVIX32-S3"
```
